## main/Kconfig.projbuild
```kconfig
menu "Board Specific Stuff"
    config NUM_I2C
        int "Number of I2C controllers accessible to the OS"
        default 1
    menu "I2C ports"
        visible if NUM_I2C > 0
        config I2C_0_SDA
            int "SDA pin for I2C 0"
            default -1
        config I2C_0_SCL
            int "SCL pin for I2C 0"
            default -1
    endmenu
        
    config NUM_SPI
        int "Number of SPI ports accessible to the OS"
        default 1
    menu "SPI ports"
        visible if NUM_SPI > 0
        menu "SPI 0"
            config SPI_0_NUMCS
                int "number of cs pins"
                default 0
            config SPI_0_MOSI
                int "MOSI pin"
                default -1
            config SPI_0_MISO
                int "MISO pin"
                default -1
            config SPI_0_SCLK
                int "SCLK pin"
                default -1
            config SPI_0_CS_0
                int "CS 0"
                default -1
                depends on SPI_0_NUMCS > 0
            config SPI_0_CS_1
                int "CS 1"
                default -1
                depends on SPI_0_NUMCS > 1
            config SPI_0_CS_2
                int "CS 2"
                default -1
                depends on SPI_0_NUMCS > 2
        endmenu
        menu "SPI 1"
            visible if NUM_SPI > 1
            config SPI_1_NUMCS
                int "number of cs pins"
                default 0
            config SPI_1_MOSI
                int "MOSI pin"
                default -1
            config SPI_1_MISO
                int "MISO pin"
                default -1
            config SPI_1_SCLK
                int "SCLK pin"
                default -1
            config SPI_1_CS_0
                int "CS 0"
                default -1
                depends on SPI_1_NUMCS > 0
            config SPI_1_CS_1
                int "CS 1"
                default -1
                depends on SPI_1_NUMCS > 1
            config SPI_1_CS_2
                int "CS 2"
                default -1
                depends on SPI_1_NUMCS > 2
        endmenu
    endmenu
    menu "SDCard"
        config USE_SDCARD
            bool "enable sd card support"
            default n
            depends on NUM_SPI > 0
        config SD_SPIBUS
            int "Select which SPI bus has a SD card"
            default -1
            depends on USE_SDCARD = y
        config SD_CSPIN
            int "sdcard chip select pin"
            default -1
            depends on USE_SDCARD = y
    endmenu
endmenu
```

## sdkconfig.defaults
```kconfig
CONFIG_ESP_CONSOLE_USB_CDC=y

CONFIG_SPIRAM=y
CONFIG_SPIRAM_MODE_QUAD=y
CONFIG_SPIRAM_TYPE_AUTO=y
CONFIG_SPIRAM_SPEED_80M=y
CONFIG_SPIRAM_SPEED=80
CONFIG_SPIRAM_BOOT_HW_INIT=y
CONFIG_SPIRAM_USE_CAPS_ALLOC=y

CONFIG_TINYUSB_DEBUG_LEVEL=1
CONFIG_TINYUSB_MODE_DMA=y
CONFIG_TINYUSB_DESC_USE_ESPRESSIF_VID=y
CONFIG_TINYUSB_DESC_USE_DEFAULT_PID=y
CONFIG_TINYUSB_DESC_BCD_DEVICE=0x0100
CONFIG_TINYUSB_DESC_MANUFACTURER_STRING="Espressif Systems"
CONFIG_TINYUSB_DESC_PRODUCT_STRING="Espressif Device"
CONFIG_TINYUSB_DESC_SERIAL_STRING="123456"
CONFIG_TINYUSB_DESC_CDC_STRING="Espressif CDC Device"
CONFIG_TINYUSB_CDC_ENABLED=y
CONFIG_TINYUSB_CDC_COUNT=1
CONFIG_TINYUSB_CDC_RX_BUFSIZE=512
CONFIG_TINYUSB_CDC_TX_BUFSIZE=512
CONFIG_TINYUSB_CDC_EP_BUFSIZE=512
```
